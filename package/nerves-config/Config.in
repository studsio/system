## package/nerves-config/Config.in
```kconfig
menuconfig BR2_PACKAGE_NERVES_CONFIG
	bool "nerves-config"
	select BR2_PACKAGE_OPENSSL   # TODO: do not think we need this -- need to confirm
	select BR2_PACKAGE_HOST_FWUP # Used by Studs packaging tools
	help
	  Nerves system configuration helper

	  https://github.com/nerves-project/nerves_system_br
```
